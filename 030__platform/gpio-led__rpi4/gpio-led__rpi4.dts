// TODO make dt-bindings work in this overlay
//#include <dt-bindings/gpio/gpio.h> /* GPIO_ACTIVE_HIGH,... */

/dts-v1/;
/plugin/;
/ {
	compatible = "raspberrypi,3-model-b", "brcm,bcm2837";
	fragment@0 {
		target = <&soc>;
		__overlay__ {
			gpio_led {
				compatible = "lothars,gpio-led";
//				mindblowing-gpios = <&gpio 21 (GPIO_ACTIVE_HIGH | GPIO_PULL_UP)>;
				mindblowing-gpios = <&gpio 21 0>;
			};
		};
	};
};
