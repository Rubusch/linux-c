/dts-v1/;
/plugin/;
/ {
	compatible = "raspberrypi,3-model-b", "brcm,bcm2835";
	fragment@0 {
		target = <&gpio>;
//		target = <&i2c1>;
		__overlay__ {
			i2c1 {
				#address-cells = <1>;
				#size-cells = <0>;
 				adxl345@1d {
 					compatible = "lothars,adxl345";
 					reg = <0x1d>;
 				};
			};
		};
	};
};
