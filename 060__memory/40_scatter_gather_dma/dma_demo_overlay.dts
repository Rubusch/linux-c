/dts-v1/;
/plugin/;
/ {
	compatible = "raspberrypi,3-model-b", "brcm,bcm2835";
	fragment@0 {
		__overlay__ {
			target = <&soc>;
 			sdma_m2m {
 				compatible = "lothars,sdma_m2m";
 			};
		};
	};
};
